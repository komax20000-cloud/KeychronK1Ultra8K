## Kconfig
```kconfig
menu "Keychron K1 Ultra module"
config KEYCHRON_K1_ULTRA_CUSTOM
    bool "Enable Keychron K1 Ultra custom board/shield support"
    default y

config RTK_DFU
    bool "Enable Realtek DFU"
    default y

config ZMK_KEY_REPEAT
    bool "Enable device-side key auto-repeat behaviors"
    default y
endmenu
```

## dts/bindings/behaviors/zmk,behavior-key-repeat-delay.yaml
```yaml
description: Key auto-repeat delay control behavior

compatible: "zmk,behavior-key-repeat-delay"

include: one_param.yaml
```

## dts/bindings/behaviors/zmk,behavior-key-repeat-multi.yaml
```yaml
description: Repeat all held keys (param 0 off, 1 on, 2 toggle)

compatible: "zmk,behavior-key-repeat-multi"

include: one_param.yaml
```

## dts/bindings/behaviors/zmk,behavior-key-repeat-pause.yaml
```yaml
description: Pause key auto-repeat for a few seconds

compatible: "zmk,behavior-key-repeat-pause"

include: zero_param.yaml
```

## dts/bindings/behaviors/zmk,behavior-key-repeat-rate.yaml
```yaml
description: Key auto-repeat rate control behavior

compatible: "zmk,behavior-key-repeat-rate"

include: one_param.yaml
```

## dts/bindings/behaviors/zmk,behavior-key-repeat-toggle.yaml
```yaml
description: Key auto-repeat toggle control behavior

compatible: "zmk,behavior-key-repeat-toggle"

include: one_param.yaml
```
